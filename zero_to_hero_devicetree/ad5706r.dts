/dts-v1/;
/plugin/;


/ {
        compatible = "raspberrypi,4-model-b", "brcm,bcm2711";
};

&spi0 {
	status = "okay";
	#address-cells = <1>;
	#size-cells = <0>;

	/* Disable default spidev to avoid CS conflict */
	spidev@0 {
		status = "disabled";
	};

	ad5706r: dac@0 {
		compatible = "adi,ad5706r";
		reg = <0>;
		spi-max-frequency = <10000000>;

		/* Pin 7 (GPIO4) for OUT_EN control */
		enable-gpios = <&gpio 4 0>;
	};
};
